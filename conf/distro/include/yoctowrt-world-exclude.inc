## conf/distro/yoctowrt.conf
```bitbake
DISTRO = "yoctowrt"
DISTRO_NAME = "Yoctowrt (Openwrt built in Yocto)"
DISTRO_VERSION = "22.03-4.0.4"
DISTRO_CODENAME = "kirkstone"

MAINTAINER = "Edwin Pers <pers.edwin@gmail.com>"

TARGET_VENDOR = "-yoctowrt"

LOCALCONF_VERSION = "2"

require conf/distro/include/yoctowrt-world-exclude.inc
require conf/distro/include/no-static-libs.inc
require conf/distro/include/yocto-uninative.inc
require conf/distro/include/security_flags.inc
INHERIT += "uninative"

YOCTOWRT_DEFAULT_DISTRO_FEATURES = "largefile multiarch"
YOCTOWRT_DEFAULT_EXTRA_RDEPENDS = "packagegroup-core-boot"
YOCTOWRT_DEFAULT_EXTRA_RRECOMMENDS = "kernel-module-af-packet"

DISTRO_FEATURES ?= "${DISTRO_FEATURES_DEFAULT} ${YOCTOWRT_DEFAULT_DISTRO_FEATURES}"

PREFERRED_VERSION_linux-yoctowrt ?= "5.10%"
PREFERRED_VERSION_linux-yoctowrt ?= "5.10%"

DISTRO_EXTRA_RDEPENDS += "${YOCTOWRT_DEFAULT_EXTRA_RDEPENDS}"
DISTRO_EXTRA_RRECOMMENDS += "${YOCTOWRT_DEFAULT_EXTRA_RRECOMMENDS}"

TCLIBCAPPEND = ""

SANITY_TESTED_DISTROS ?= " \
  debian-11 \n \
"

BB_SIGNATURE_HANDLER ?= "OEEquivHash"
BB_HASHSERVE ??= "auto"
```

## conf/layer.conf
```bitbake
# We have a conf and classes directory, append to BBPATH
BBPATH .= ":${LAYERDIR}"

# We have a recipes directory, add to BBFILES
BBFILES += "${LAYERDIR}/recipes*/*/*.bb ${LAYERDIR}/recipes*/*/*.bbappend"

BBFILE_COLLECTIONS += "yoctowrt-layer"
BBFILE_PATTERN_yoctowrt-layer := "^${LAYERDIR}/"
BBFILE_PRIORITY_yoctowrt-layer = "10"

LAYERDEPENDS_yoctowrt-layer = "core openembedded-layer networking-layer"

LAYERSERIES_COMPAT_yoctowrt-layer = "kirkstone"
```
